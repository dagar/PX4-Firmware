## ROMFS/Kconfig
```kconfig
menuconfig ROMFS_AIRFRAMES
	bool "esc_battery"
	default n
	---help---
		Enable support for esc_battery
```

## src/drivers/distance_sensor/nra15/Kconfig
```kconfig
menuconfig DRIVERS_DISTANCE_SENSOR_NRA15
	bool "nra15"
	default n
	---help---
		Enable support for Nanorader NRA15
```

## src/drivers/gnss/ublox/Kconfig
```kconfig
menuconfig DRIVERS_GNSS_UBX
	bool "GNSS ublox"
	default n
	---help---
		Enable support for ublox GNSS

menuconfig USER_GNSS_UBX
	bool "ublox GNSS running as userspace module"
	default y
	depends on BOARD_PROTECTED && DRIVERS_GNSS_UBX
	---help---
		Put ublox gnss in userspace memory
```

## src/drivers/rc/Kconfig
```kconfig
menu "RC"
    menuconfig COMMON_RC
        bool "Common RC drivers"
        default n
        select DRIVERS_RC_CRSF
        select DRIVERS_RC_DSM
        select DRIVERS_RC_GHST
        #select DRIVERS_RC_PPM
        select DRIVERS_RC_SBUS
        select DRIVERS_RC_ST24
        select DRIVERS_RC_SUMD
        ---help---
            Enable default set of RC drivers
    rsource "*/Kconfig"
endmenu
```

## src/drivers/rc/crsf/Kconfig
```kconfig
menuconfig DRIVERS_RC_CRSF
	bool "rc_crsf"
	default n
	---help---
		Enable support for rc_crsf
```

## src/drivers/rc/dsm/Kconfig
```kconfig
menuconfig DRIVERS_RC_DSM
	bool "rc_dsm"
	default n
	---help---
		Enable support for rc_dsm
```

## src/drivers/rc/ghst/Kconfig
```kconfig
menuconfig DRIVERS_RC_GHST
	bool "rc_ghst"
	default n
	---help---
		Enable support for rc_ghst
```

## src/drivers/rc/ppm/Kconfig
```kconfig
menuconfig DRIVERS_RC_PPM
	bool "rc_ppm"
	default n
	---help---
		Enable support for rc_ppm
```

## src/drivers/rc/sbus/Kconfig
```kconfig
menuconfig DRIVERS_RC_SBUS
	bool "rc_sbus"
	default n
	---help---
		Enable support for rc_sbus
```

## src/drivers/rc/st24/Kconfig
```kconfig
menuconfig DRIVERS_RC_ST24
	bool "rc_st24"
	default n
	---help---
		Enable support for rc_st24
```

## src/drivers/rc/sumd/Kconfig
```kconfig
menuconfig DRIVERS_RC_SUMD
	bool "rc_sumd"
	default n
	---help---
		Enable support for rc_sumd
```

## src/drivers/smart_battery/bq40zxy/Kconfig
```kconfig
menuconfig DRIVERS_SMART_BATTERY_BQ40ZXY
	bool "bq40zxy"
	default n
	---help---
		Enable support for bq40zxy
```

## src/drivers/smart_battery/bq78350/Kconfig
```kconfig
menuconfig DRIVERS_SMART_BATTERY_BQ78350
	bool "bq78350"
	default n
	---help---
		Enable support for bq78350
```

## src/modules/mc_indi_att_rate_control/Kconfig
```kconfig
menuconfig MODULES_MC_INDI_ATT_RATE_CONTROL
	bool "mc_indi_att_rate_control"
	default n
	---help---
		Enable support for mc_indi_att_rate_control
```

## src/modules/mc_pid_cascade_control/Kconfig
```kconfig
menuconfig MODULES_MC_PID_CASCADE_CONTROL
	bool "mc_pid_cascade_control"
	default n
	---help---
		Enable support for mc_pid_cascade_control

menuconfig USER_MC_PID_CASCADE_CONTROL
	bool "mc_pid_cascade_control running as userspace module"
	default n
	depends on BOARD_PROTECTED && MODULES_MC_PID_CASCADE_CONTROL
	---help---
		Put mc_pid_cascade_control in userspace memory
```

## src/modules/msg_bridge/Kconfig
```kconfig
menuconfig MODULES_MSG_BRIDGE
	bool "msg_bridge"
	default n
	---help---
		Enable support for msg_bridge
```

## src/modules/output_predictor/Kconfig
```kconfig
menuconfig MODULES_OUTPUT_PREDICTOR
	bool "output_predictor"
	default n
	---help---
		Enable support for output_predictor
```

## src/modules/simulation/simulator_airplane/Kconfig
```kconfig
menuconfig MODULES_SIMULATION_SIMULATOR_AIRPLANE
	bool "simulator_airplane"
	default n
	---help---
		Enable support for simulator_airplane
```

## src/modules/simulation/simulator_quadx/Kconfig
```kconfig
menuconfig MODULES_SIMULATION_SIMULATOR_QUADX
	bool "simulator_quadx"
	default n
	---help---
		Enable support for simulator_quadx
```

## src/modules/simulation/simulator_tailsitter/Kconfig
```kconfig
menuconfig MODULES_SIMULATION_SIMULATOR_TAILSITTER
	bool "simulator_tailsitter"
	default n
	---help---
		Enable support for simulator_tailsitter
```

## src/modules/ukf24/Kconfig
```kconfig
menuconfig MODULES_UKF24
	bool "ukf24"
	default n
	---help---
		Enable support for ukf24
```

## src/modules/vehicle_model_estimator/Kconfig
```kconfig
menuconfig MODULES_VEHICLE_MODEL_ESTIMATOR
	bool "vehicle_model_estimator"
	default n
	---help---
		Enable support for vehicle_model_estimator

menuconfig USER_MODULES_VEHICLE_MODEL_ESTIMATOR
	bool "vehicle_model_estimator running as userspace module"
	default y
	depends on BOARD_PROTECTED && MODULES_VEHICLE_MODEL_ESTIMATOR
	---help---
		Put vehicle_model_estimator in userspace memory
```

## src/modules/vtol_control_allocator/Kconfig
```kconfig
menuconfig MODULES_VTOL_CONTROL_ALLOCATOR
	bool "vtol_control_allocator"
	default n
	---help---
		Enable support for vtol_control_allocator

menuconfig USER_VTOL_CONTROL_ALLOCATOR
	bool "vtol_control_allocator running as userspace module"
	default y
	depends on BOARD_PROTECTED && MODULES_VTOL_CONTROL_ALLOCATOR
	---help---
		Put control_allocator in userspace memory
```

## src/systemcmds/serial_passthrough/Kconfig
```kconfig
menuconfig SYSTEMCMDS_SERIAL_PASSTHROUGH
	bool "serial_passthrough"
	default n
	---help---
		Enable support for serial passthrough
```
